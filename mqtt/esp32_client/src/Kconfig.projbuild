## mqtt/esp32_client/src/Kconfig.projbuild
```kconfig
menu "Example MQTT Configuration"

    config BROKER_URL
        string "MQTT Broker URL"
        default "mqtt://DESKTOP-BARRO:1883"
        help
            URL of the broker to connect to (mqtt/mqtt.org/wiki/URI-Scheme)

endmenu
```

## mqtt/esp32_proto_client/src/Kconfig.projbuild
```kconfig
menu "Example MQTT Configuration"

    config BROKER_HOSTNAME
        string "MQTT Broker Hostname"
        default "DESKTOP-BARRO"
        help
            Hostname of the broker to connect to

    config BROKER_PORT
        int "MQTT Broker Port"
        default 1883
        help
            Set the port user for the broker to connect to
endmenu
```
